/* source key position labels */
#include "zmk-helpers/key-labels/42.h"

/* map Zen's extra keys */
#define X_LT  &kp TAB
#define X_LM  &kp ESC
#define X_LB  &kp LSHFT

#define X_RT  &kp BSLH
#define X_RM  &kp SQT
#define X_RB  &kp RSHFT

#define X_LH  &mo NUM
#define X_RH  &mo NAV

/* #define X_LH  &kp LGUI      // thumb row, left */
/* #define X_RH  &smart_mouse  // thumb row, right */

/* activate bluetooth */
#define CONFIG_WIRELESS 1

/* source the main keymap */
#include "trevorj.keymap"

/* use 5-column layout for Zen */
/* ZMK_APPLY_MATRIX_TRANSFORM(five_column_transform) */

/ {
  chosen {
    zmk,matrix_transform = &default_transform;
  };
};

/* vim: set ts=2 sw=2 tw=120 ft=c noet :*/
