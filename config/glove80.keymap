/* source key position labels */
#include "zmk-helpers/key-labels/glove80.h"

/*                               GLOVE80 KEY MATRIX / LAYOUT MAPPING
 ╭────────────────────╮       ╭────────────────────╮ ╭────────────────────╮       ╭────────────────────╮
 │  0   1   2   3   4 ╰───┬───╯  5   6   7   8   9 │ │ LC5 LC4 LC3 LC2 LC1╰───┬───╯ RC1 RC2 RC3 RC4 RC5│
 │ 10  11  12  13  14  15 │ 16  17  18  19  20  21 │ │ LN5 LN4 LN3 LN2 LN1 LN0│ RN0 RN1 RN2 RN3 RN4 RN5│
 │ 22  23  24  25  26  27 │ 28  29  30  31  32  33 │ │ LT5 LT4 LT3 LT2 LT1 LT0│ RT0 RT1 RT2 RT3 RT4 RT5│
 │ 34  35  36  37  38  39 │ 40  41  42  43  44  45 │ │ LM5 LM4 LM3 LM2 LM1 LM0│ RM0 RM1 RM2 RM3 RM4 RM5│
 │ 46  47  48  49  50  51 │ 58  59  60  61  62  63 │ │ LB5 LB4 LB3 LB2 LB1 LB0│ RB0 RB1 RB2 RB3 RB4 RB5│
 │ 64  65  66  67  68 ╭───┴───╮ 75  76  77  78  79 │ │ LF5 LF4 LF3 LF2 LF1╭───┴───╮ RF1 RF2 RF3 RF4 RF5│
 ╰───────────┬────────┴───┬───┴────────┬───────────╯ ╰───────────┬────────┴───┬───┴────────┬───────────╯
             │ 52  53  54 │ 55  56  57 │                         │ LH5 LH4 LH3│ RH3 RH4 RH5│
             │ 69  70  71 │ 72  73  74 │                         │ LH2 LH1 LH0│ RH0 RH1 RH2│
             ╰────────────┴────────────╯                         ╰────────────┴────────────╯
 */

/* map the Glove's extra keys */
#define X_LT  \
                &kp F1    &kp F2 &kp F3 &kp F4 &kp F5                 &kp F6 &kp F7 &kp F8 &kp F9 &kp F10 \
                &kp EQUAL &kp N1 &kp N2 &kp N3 &kp N4 &kp N5   &kp N6 &kp N7 &kp N8 &kp N9 &kp N0 &kp MINUS \
                &kp TAB
#define X_RT  &kp BSLH

#define X_LM  &kp ESC
#define X_RM  &kp SQT

#define X_LB  &kp LSHFT
//              LSHIFT LCTRL LLAYER  RSYS RCTRL RSHIFT
#define X_MB    &mo NUM  &lt FN BSPC  &mt LGUI DEL    &mo NAV  &kp RET  &kp SPC
#define X_RB  &kp RSHFT

//              MAGIC HOME END LEFT RIGHT
#define X_LH    &none &none &none &none &mo NUM
//              LALT RALT
#define X_MH    &none &none
//              UP DOWN LBRACK RBRACK PGDN
#define X_RH    &mo NAV &none &none &none &none

/* activate bluetooth */
#define CONFIG_WIRELESS 1

/* source the main keymap */
#include "trevorj.keymap"

/* vim: set ts=2 sw=2 tw=120 ft=c noet :*/
